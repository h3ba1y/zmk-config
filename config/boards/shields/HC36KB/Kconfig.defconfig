## config/boards/shields/HC36KB/Kconfig.defconfig
```kconfig
# Copyright (c) 2020 The ZMK Contributors
# SPDX-License-Identifier: MIT

if SHIELD_HC36KB

config ZMK_KEYBOARD_NAME
    default "hc36kb"

endif
```

## config/boards/shields/HC36KB/Kconfig.shield
```kconfig
 #
 # Copyright (c) 2020 The ZMK Contributors
 #
 # SPDX-License-Identifier: MIT
 #

config SHIELD_HC36KB
    def_bool $(shields_list_contains,HC36KB)
```
